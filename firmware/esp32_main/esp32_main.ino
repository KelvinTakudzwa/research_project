// ============================================================
// ESP32 Solar Diagnostics System — IoT Node Firmware
// Sensor Contract v3.0 — MQTTS (TLS 1.2) + Full Hardware Reads
//
// Required libraries (install via Arduino Library Manager):
//   - "MQTT"             by Joel Gaehwiler    (QoS 1 PUBACK)
//   - "RTClib"           by Adafruit          (DS3231 hardware clock)
//   - "ArduinoJson"      by Arduino           (JSON serialization)
//   - "BH1750"           by Christopher Laws  (I2C light sensor)
//   - "PZEM-004T-10A"    by ByPowerLabs       (AC power meter, v3.0)
//   - "DallasTemperature" + "OneWire"          (DS18B20 probe)
//   - "LiquidCrystal I2C" by Frank de Brabander (LCD1602 display)
//
// ── PZEM-004T AVAILABILITY FLAG ─────────────────────────────
// Set to false if you do not yet have the PZEM-004T module.
// AC fields will publish as 0.0 until the hardware is connected.
#define PZEM_ENABLED false
// ────────────────────────────────────────────────────────────

#include <WiFi.h>
#include <WiFiClientSecure.h>   // TLS 1.2 transport (replaces plain WiFiClient)
#include <MQTT.h>               // Joel Gaehwiler — true QoS 1 publishing
#include <ArduinoJson.h>
#include <LittleFS.h>
#include <Wire.h>
#include <RTClib.h>
#include <Preferences.h>
#include <OneWire.h>
#include <DallasTemperature.h>
#include <BH1750.h>
#include <LiquidCrystal_I2C.h>
#if PZEM_ENABLED
  #include <PZEM004Tv30.h>
#endif

// ============================================================
// NETWORK & BROKER CONFIGURATION
// TODO: Update WIFI credentials and BROKER IP before flashing!
// BROKER_IP = the local IP of the machine running Docker
//             (run `ipconfig` on Windows, look for your LAN adapter)
// ============================================================
const char* WIFI_SSID        = "YOUR_WIFI_SSID";
const char* WIFI_PASSWORD    = "YOUR_WIFI_PASSWORD";
const char* MQTT_BROKER_IP   = "192.168.1.XX";
const int   MQTT_BROKER_PORT = 8883;               // MQTTS — TLS 1.2
const char* MQTT_CLIENT_ID   = "ESP32_SolarNode_01";
const char* MQTT_TOPIC       = "solar/data";

// ============================================================
// CA CERTIFICATE — self-signed root for MQTTS broker verification
// Generated by scripts/generate_certs.py in the project root.
// Regenerate and re-flash if you recreate the broker certs.
// ============================================================
const char CA_CERT[] PROGMEM = R"EOF(
-----BEGIN CERTIFICATE-----
MIIDXzCCAkegAwIBAgIUKC6YTs3gZ8u6p2WOPHoAt0ck2wUwDQYJKoZIhvcNAQEL
BQAwXzELMAkGA1UEBhMCWlcxFDASBgNVBAgMC01hc2hvbmFsYW5kMQ8wDQYDVQQH
DAZIYXJhcmUxEjAQBgNVBAoMCVNvbGFyUERNUzEVMBMGA1UEAwwMU29sYXJQRE1T
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FrV6/saMDMqerC2iPbPIesrZgarQcP9tvhlRTDGk7hL+tCQRWg8dGrgp/eOgF+/I
5puJ
-----END CERTIFICATE-----
)EOF";

// ============================================================
// GPIO PIN ASSIGNMENTS
// All ADC pins are from ADC1 — the only bank safe to use while
// WiFi is active. ADC2 (GPIO0,2,4,12-15,25-27) is shared with
// the WiFi radio and returns corrupt readings when WiFi is on.
// ============================================================
const int PIN_PV_VOLTAGE   = 34;   // ADC1 ch6 — voltage divider output
const int PIN_BATT_VOLTAGE = 35;   // ADC1 ch7 — voltage divider output
const int PIN_PV_CURRENT   = 36;   // ADC1 ch0 (VP) — ACS712 #1 output
const int PIN_BATT_CURRENT = 39;   // ADC1 ch3 (VN) — ACS712 #2 output
const int ONE_WIRE_BUS     = 4;    // DS18B20 waterproof probe (1-Wire)
// I2C: SDA=GPIO21, SCL=GPIO22 (shared: DS3231 + BH1750, Wire.begin() covers both)
// UART2 for PZEM-004T: RX=GPIO16, TX=GPIO17

// ============================================================
// VOLTAGE DIVIDER RATIOS
// PV   : R1=100kΩ, R2=15kΩ  → ratio = (100+15)/15  = 7.67
//        Max measurable: 3.3V × 7.67 = 25.3V  (OC voltage ~21.6V ✓)
// Batt : R1=100kΩ, R2=27kΩ  → ratio = (100+27)/27  = 4.70
//        Max measurable: 3.3V × 4.70 = 15.5V  (bulk charge ~14.4V ✓)
// Adjust these if you use different resistor values.
// ============================================================
const float PV_DIVIDER_RATIO   = 7.67f;
const float BATT_DIVIDER_RATIO = 4.70f;

// ACS712-20A sensitivity = 100mV/A.
// Use ACS712-20A for both channels (supports ±20A — covers max PV
// current of ~16.7A on a 200W/12V system).
const float ACS712_SENSITIVITY = 0.1f;    // V per Ampere

// ============================================================
// DS3231 RTC
// ============================================================
const char* NTP_SERVER    = "pool.ntp.org";
const long  GMT_OFFSET    = 0;
const int   DST_OFFSET    = 0;

RTC_DS3231 rtc;
bool       rtcAvailable = false;

unsigned long lastSyncMillis = 0;
time_t        lastNtpTime    = 0;
bool          timeSynced     = false;

// ============================================================
// ACS712 CALIBRATION — stored in NVS (survives power cycles)
// ============================================================
Preferences preferences;
int pvZeroPoint   = 2047;   // Default: ADC midpoint (1.65V on 3.3V rail)
int battZeroPoint = 2047;   // ACS712 #2 — battery current sensor

// BH1750 nighttime auto-calibration state
unsigned long darkStartTime   = 0;
bool          isDark          = false;
bool          pvCalibratedToday = false;
const int     DARK_THRESHOLD_LUX = 2;
const long    DARK_DURATION_MS   = 300000;  // 5 minutes of pitch black

// ============================================================
// HARDWARE OBJECTS
// ============================================================
OneWire        oneWire(ONE_WIRE_BUS);
DallasTemperature ds18b20(&oneWire);
BH1750         bh1750;
LiquidCrystal_I2C lcd(0x27, 16, 2);   // PCF8574 backpack, 16 cols × 2 rows
int            lcdPage = 0;            // Cycles: 0=PV, 1=Battery, 2=Env
#if PZEM_ENABLED
  PZEM004Tv30  pzem(Serial2, 16, 17);  // RX=16, TX=17
#endif

// ============================================================
// STORE & FORWARD
// ============================================================
const char* BACKLOG_FILE   = "/backlog.txt";
const int   BURST_CHUNK_SZ = 5;
const int   PAYLOAD_MAX_SZ = 768;   // expanded for 13-field payload

// ============================================================
// MQTT & TLS CLIENTS
// ============================================================
WiFiClientSecure wifiNet;
MQTTClient       mqttClient(PAYLOAD_MAX_SZ);

// ============================================================
// HELPER: Read voltage through a resistor divider
// ============================================================
float readVoltage(int pin, float dividerRatio) {
  // Average 64 samples to reduce ADC noise
  long sum = 0;
  for (int i = 0; i < 64; i++) sum += analogRead(pin);
  float adcVoltage = (sum / 64.0f) * 3.3f / 4095.0f;
  return adcVoltage * dividerRatio;
}

// ============================================================
// HELPER: Read current from ACS712 (signed — positive=source, negative=sink)
// ============================================================
float readCurrent(int pin, int zeroPoint) {
  long sum = 0;
  for (int i = 0; i < 64; i++) sum += analogRead(pin);
  float adcVoltage  = (sum / 64.0f) * 3.3f / 4095.0f;
  float zeroVoltage = zeroPoint * 3.3f / 4095.0f;
  return (adcVoltage - zeroVoltage) / ACS712_SENSITIVITY;
}

// ============================================================
// HELPER: ISO 8601 timestamp from DS3231 → NTP → epoch fallback
// ============================================================
String getIsoTimestamp() {
  char buf[25];

  if (rtcAvailable && !rtc.lostPower()) {
    DateTime now = rtc.now();
    snprintf(buf, sizeof(buf), "%04d-%02d-%02dT%02d:%02d:%02dZ",
             now.year(), now.month(), now.day(),
             now.hour(), now.minute(), now.second());
    return String(buf);
  }

  if (timeSynced) {
    // Opportunistic re-sync every hour while online
    if (WiFi.status() == WL_CONNECTED && (millis() - lastSyncMillis > 3600000)) {
      syncNTP();
    }
    time_t t = lastNtpTime + ((millis() - lastSyncMillis) / 1000);
    struct tm* tm_info = gmtime(&t);
    strftime(buf, sizeof(buf), "%Y-%m-%dT%H:%M:%SZ", tm_info);
    return String(buf);
  }

  return String("1970-01-01T00:00:00Z");  // no reliable time source
}

// ============================================================
// WIFI
// ============================================================
void connectWiFi() {
  WiFi.begin(WIFI_SSID, WIFI_PASSWORD);
  Serial.print("[WiFi] Connecting");
  int attempts = 0;
  while (WiFi.status() != WL_CONNECTED && attempts < 20) {
    delay(500);
    Serial.print(".");
    attempts++;
  }
  if (WiFi.status() == WL_CONNECTED) {
    Serial.printf("\n[WiFi] Connected. IP: %s\n", WiFi.localIP().toString().c_str());
  } else {
    Serial.println("\n[WiFi] Failed. Will retry in loop.");
  }
}

// ============================================================
// NTP SYNC — also sets DS3231 hardware clock
// ============================================================
void syncNTP() {
  if (WiFi.status() != WL_CONNECTED) {
    if (rtcAvailable && !rtc.lostPower()) {
      Serial.println("[NTP] Wi-Fi unavailable. DS3231 providing time.");
    } else {
      Serial.println("[NTP] Wi-Fi unavailable. No reliable time source.");
    }
    return;
  }

  configTime(GMT_OFFSET, DST_OFFSET, NTP_SERVER);
  struct tm timeinfo;
  if (getLocalTime(&timeinfo)) {
    time(&lastNtpTime);
    lastSyncMillis = millis();
    timeSynced     = true;
    Serial.println("[NTP] Time synced successfully.");
    if (rtcAvailable) {
      rtc.adjust(DateTime(lastNtpTime));
      Serial.println("[RTC] DS3231 clock set from NTP.");
    }
  } else {
    Serial.println("[NTP] Sync failed.");
  }
}

// ============================================================
// ACS712 CALIBRATION — PV sensor (triggered by BH1750 nighttime)
// ============================================================
void calibratePV() {
  Serial.println("[ACS712] PV auto-calibration (pitch-black condition)...");
  long sum = 0;
  for (int i = 0; i < 200; i++) {
    sum += analogRead(PIN_PV_CURRENT);
    delayMicroseconds(100);
  }
  pvZeroPoint = sum / 200;
  preferences.putInt("pvZero", pvZeroPoint);
  pvCalibratedToday = true;
  Serial.printf("[ACS712] PV zero baseline updated: %d\n", pvZeroPoint);
}

// ============================================================
// ACS712 CALIBRATION — battery current sensor (MQTT triggered)
// Send: topic=solar/control, payload={"cmd":"calibrate_battery"}
// Run with inverter disconnected and PV disconnected (true zero current).
// ============================================================
void calibrateBattery() {
  Serial.println("[ACS712] Battery sensor calibration...");
  long sum = 0;
  for (int i = 0; i < 200; i++) {
    sum += analogRead(PIN_BATT_CURRENT);
    delayMicroseconds(100);
  }
  battZeroPoint = sum / 200;
  preferences.putInt("battZero", battZeroPoint);
  Serial.printf("[ACS712] Battery zero baseline updated: %d\n", battZeroPoint);
}

// ============================================================
// MQTT MESSAGE HANDLER
// ============================================================
void messageReceived(String &topic, String &payload) {
  Serial.println("[MQTT] Incoming: " + topic + " -> " + payload);
  if (topic == "solar/control") {
    StaticJsonDocument<256> doc;
    DeserializationError err = deserializeJson(doc, payload);
    if (!err) {
      if (doc["cmd"] == "calibrate_battery") calibrateBattery();
      if (doc["cmd"] == "calibrate_pv")      calibratePV();
    }
  }
}

// ============================================================
// MQTT CONNECTION (uses WiFiClientSecure → TLS 1.2 on port 8883)
// ============================================================
void connectMQTT() {
  mqttClient.begin(MQTT_BROKER_IP, MQTT_BROKER_PORT, wifiNet);
  mqttClient.onMessage(messageReceived);

  Serial.print("[MQTT] Connecting (MQTTS port 8883)");
  int attempts = 0;
  while (!mqttClient.connect(MQTT_CLIENT_ID) && attempts < 10) {
    Serial.print(".");
    delay(500);
    attempts++;
  }
  if (mqttClient.connected()) {
    Serial.printf("\n[MQTT] Connected via TLS. Publishing to: %s (QoS 1)\n", MQTT_TOPIC);
    mqttClient.subscribe("solar/control", 1);
  } else {
    Serial.println("\n[MQTT] Broker unreachable. Will store data locally.");
  }
}

// ============================================================
// STORE & FORWARD — LittleFS NDJSON append (corruption-safe)
//
// Accepts the JsonDocument by reference so it can stamp the
// record as buffered BEFORE serializing to the file.
// This ensures is_offline_buffered and record_source are correct
// on every record the backend will eventually receive.
// ============================================================
void storeLocally(StaticJsonDocument<768>& doc) {
  doc["is_offline_buffered"] = true;
  doc["record_source"]       = "store_and_forward";

  String line;
  serializeJson(doc, line);

  File file = LittleFS.open(BACKLOG_FILE, "a");
  if (!file) {
    Serial.println("[LittleFS] ERROR: Cannot open backlog for writing.");
    return;
  }
  file.println(line);
  file.close();
  Serial.println("[LittleFS] Reading stored (is_offline_buffered=true, store_and_forward).");
}

// ============================================================
// DRAIN BACKLOG — WDT-safe chunked burst recovery
// ============================================================
void sendBacklog() {
  if (!LittleFS.exists(BACKLOG_FILE)) return;

  File file = LittleFS.open(BACKLOG_FILE, "r");
  if (!file || file.size() == 0) {
    if (file) file.close();
    return;
  }

  Serial.printf("[LittleFS] Backlog found (%d bytes). Starting chunked burst...\n", file.size());

  std::vector<String> lines;
  while (file.available()) {
    String line = file.readStringUntil('\n');
    line.trim();
    if (line.length() > 0) lines.push_back(line);
  }
  file.close();

  int total   = lines.size();
  int success = 0;

  for (int i = 0; i < total; i++) {
    bool ok = mqttClient.publish(MQTT_TOPIC, lines[i], false, 1);
    if (ok) {
      success++;
    } else {
      Serial.printf("[MQTT] Publish failed at backlog line %d — stopping burst.\n", i);
      break;
    }
    if ((i + 1) % BURST_CHUNK_SZ == 0) {
      mqttClient.loop();
      yield();
      delay(10);
      Serial.printf("[MQTT] Burst chunk: %d/%d sent.\n", i + 1, total);
    }
  }

  Serial.printf("[MQTT] Burst complete: %d/%d delivered.\n", success, total);

  if (success == total) {
    LittleFS.remove(BACKLOG_FILE);
    Serial.println("[LittleFS] Backlog cleared.");
  } else {
    Serial.println("[LittleFS] Partial burst — backlog kept for next retry.");
  }
}

// ============================================================
// SETUP
// ============================================================
void setup() {
  Serial.begin(115200);

  // ADC attenuation: 11dB gives 0–3.6V input range on all ADC1 pins
  analogSetAttenuation(ADC_11db);

  // NVS — load calibration baselines
  preferences.begin("solar_cal", false);
  pvZeroPoint   = preferences.getInt("pvZero",   2047);
  battZeroPoint = preferences.getInt("battZero", 2047);
  Serial.printf("[ACS712] Loaded baselines — PV: %d  Batt: %d\n",
                pvZeroPoint, battZeroPoint);

  // I2C bus (shared: DS3231 + BH1750, both on default SDA=21 SCL=22)
  Wire.begin();

  // DS3231 hardware RTC
  if (rtc.begin()) {
    rtcAvailable = true;
    Serial.println("[RTC] DS3231 detected.");
    if (rtc.lostPower()) {
      Serial.println("[RTC] WARNING: Lost power — timestamp invalid until NTP sync.");
    } else {
      DateTime now = rtc.now();
      Serial.printf("[RTC] Time: %04d-%02d-%02d %02d:%02d:%02d\n",
                    now.year(), now.month(), now.day(),
                    now.hour(), now.minute(), now.second());
    }
  } else {
    Serial.println("[RTC] DS3231 NOT found — falling back to NTP/millis().");
  }

  // BH1750 light sensor (I2C address 0x23, shares bus with DS3231)
  if (bh1750.begin(BH1750::CONTINUOUS_HIGH_RES_MODE)) {
    Serial.println("[BH1750] Light sensor initialized.");
  } else {
    Serial.println("[BH1750] WARNING: Not found on I2C bus — irradiance will read 0.");
  }

  // DS18B20 battery temperature probe
  ds18b20.begin();
  Serial.println("[DS18B20] Temperature probe initialized on GPIO 4.");

  // LCD1602 I2C display (PCF8574 @ 0x27, shared I2C bus with BH1750 + DS3231)
  lcd.init();
  lcd.backlight();
  lcd.setCursor(0, 0);
  lcd.print(" Solar Diag Sys ");
  lcd.setCursor(0, 1);
  lcd.print(" Initialising... ");
  Serial.println("[LCD] Display initialized.");

  // PZEM-004T AC power meter (UART2: RX=16, TX=17)
  #if PZEM_ENABLED
    Serial2.begin(9600, SERIAL_8N1, 16, 17);
    Serial.println("[PZEM] AC power meter initialized on UART2 (RX=16, TX=17).");
  #else
    Serial.println("[PZEM] PZEM_ENABLED=false — AC fields will publish as 0.0.");
  #endif

  // LittleFS for store-and-forward
  if (!LittleFS.begin(true)) {
    Serial.println("[LittleFS] CRITICAL: Mount failed.");
    return;
  }
  Serial.println("[LittleFS] Mounted.");

  // TLS — load CA certificate into the secure client before connecting
  wifiNet.setCACert(CA_CERT);
  Serial.println("[TLS] CA certificate loaded.");

  connectWiFi();
  syncNTP();
  connectMQTT();
}

// ============================================================
// LCD UPDATE HELPER — called every loop, before WiFi/MQTT block
// so the display refreshes even when the broker is unreachable.
// Cycles: page 0 = PV | page 1 = Battery | page 2 = Environment
// ============================================================
void updateLCD(float pv_voltage_v,    float pv_current_a,
               float battery_voltage_v, float battery_current_a,
               float irradiance_wm2,  float ambient_temp_c,
               float battery_temp_c) {
  char row0[17], row1[17];   // 16 visible chars + null terminator

  lcd.clear();

  if (lcdPage == 0) {
    float pv_power_w = pv_voltage_v * pv_current_a;
    snprintf(row0, sizeof(row0), "PV %5.1fV %4.1fA", pv_voltage_v, pv_current_a);
    snprintf(row1, sizeof(row1), "Pwr   %6.1f W  ",  pv_power_w);
  } else if (lcdPage == 1) {
    // Simple SoC estimate from terminal voltage (lead-acid: 11.8V=0%, 14.4V=100%)
    int soc = constrain((int)((battery_voltage_v - 11.8f) / (14.4f - 11.8f) * 100.0f), 0, 100);
    const char* mode = (battery_current_a >=  0.05f) ? "CHG" :
                       (battery_current_a <= -0.05f) ? "DSC" : "FLT";
    snprintf(row0, sizeof(row0), "BT %5.1fV %4.1fA", battery_voltage_v, battery_current_a);
    snprintf(row1, sizeof(row1), "SoC %3d%%   [%s]", soc, mode);
  } else {
    snprintf(row0, sizeof(row0), "Irr %5.0f W/m2 ", irradiance_wm2);
    snprintf(row1, sizeof(row1), "T:%4.1fC B:%4.1fC", ambient_temp_c, battery_temp_c);
  }

  lcd.setCursor(0, 0); lcd.print(row0);
  lcd.setCursor(0, 1); lcd.print(row1);

  lcdPage = (lcdPage + 1) % 3;   // advance page for next reading
}

// ============================================================
// MAIN LOOP
// ============================================================
void loop() {
  mqttClient.loop();  // Process MQTT keep-alive and PUBACK responses

  // ── PV SUBSYSTEM ────────────────────────────────────────────
  float pv_voltage_v = readVoltage(PIN_PV_VOLTAGE, PV_DIVIDER_RATIO);
  float pv_current_a = readCurrent(PIN_PV_CURRENT, pvZeroPoint);
  // Clamp negative PV current to 0 (diode prevents reverse flow)
  if (pv_current_a < 0.0f) pv_current_a = 0.0f;

  // ── BATTERY SUBSYSTEM ───────────────────────────────────────
  float battery_voltage_v = readVoltage(PIN_BATT_VOLTAGE, BATT_DIVIDER_RATIO);
  // battery_current_a is signed: positive = charging, negative = discharging
  float battery_current_a = readCurrent(PIN_BATT_CURRENT, battZeroPoint);

  // ── AC SUBSYSTEM (PZEM-004T) ─────────────────────────────────
  float ac_voltage_v    = 0.0f;
  float ac_current_a    = 0.0f;
  float ac_power_w      = 0.0f;
  float ac_power_factor = 0.0f;

  #if PZEM_ENABLED
    float _acv = pzem.voltage();
    float _aci = pzem.current();
    float _acp = pzem.power();
    float _acpf = pzem.pf();
    // Guard: PZEM returns NaN when disconnected or no AC load present
    if (!isnan(_acv))  ac_voltage_v    = _acv;
    if (!isnan(_aci))  ac_current_a    = _aci;
    if (!isnan(_acp))  ac_power_w      = _acp;
    if (!isnan(_acpf)) ac_power_factor = _acpf;
  #endif

  // ── IRRADIANCE (BH1750 I2C) ─────────────────────────────────
  float lux_raw        = bh1750.readLightLevel();
  float irradiance_wm2 = (lux_raw > 0.0f) ? (lux_raw / 120.0f) : 0.0f;

  // ── BH1750 NIGHTTIME TRICK — PV AUTO-CALIBRATION ────────────
  // 5 minutes of pitch-black triggers an ACS712 zero-point update
  if (lux_raw < DARK_THRESHOLD_LUX) {
    if (!isDark) {
      isDark        = true;
      darkStartTime = millis();
    } else if (!pvCalibratedToday && (millis() - darkStartTime > DARK_DURATION_MS)) {
      calibratePV();
    }
  } else {
    isDark = false;
    if (lux_raw > 100) pvCalibratedToday = false;  // Reset daily flag at sunrise
  }

  // ── TEMPERATURES ────────────────────────────────────────────
  // Ambient: DS3231 internal thermistor (enclosure air temperature)
  float ambient_temp_c = rtcAvailable ? rtc.getTemperature() : 25.0f;

  // Battery surface: DS18B20 waterproof probe
  ds18b20.requestTemperatures();
  float battery_temp_c = ds18b20.getTempCByIndex(0);
  if (battery_temp_c == DEVICE_DISCONNECTED_C) battery_temp_c = 25.0f;

  // ── LCD UPDATE (always — independent of WiFi/MQTT state) ─────
  updateLCD(pv_voltage_v, pv_current_a,
            battery_voltage_v, battery_current_a,
            irradiance_wm2, ambient_temp_c, battery_temp_c);

  // ── BUILD JSON PAYLOAD ───────────────────────────────────────
  StaticJsonDocument<768> doc;
  doc["pv_voltage_v"]        = round(pv_voltage_v      * 100) / 100.0;
  doc["pv_current_a"]        = round(pv_current_a      * 100) / 100.0;
  doc["battery_voltage_v"]   = round(battery_voltage_v * 100) / 100.0;
  doc["battery_current_a"]   = round(battery_current_a * 100) / 100.0;
  doc["ac_voltage_v"]        = round(ac_voltage_v      * 100) / 100.0;
  doc["ac_current_a"]        = round(ac_current_a      * 1000) / 1000.0;
  doc["ac_power_w"]          = round(ac_power_w        * 10)  / 10.0;
  doc["ac_power_factor"]     = round(ac_power_factor   * 1000) / 1000.0;
  doc["irradiance_wm2"]      = round(irradiance_wm2    * 10)  / 10.0;
  doc["ambient_temp_c"]      = round(ambient_temp_c    * 100) / 100.0;
  doc["battery_temp_c"]      = round(battery_temp_c    * 100) / 100.0;
  doc["timestamp"]           = getIsoTimestamp();
  // Firmware explicitly marks the source — is_offline_buffered and record_source
  // are set here for live readings; storeLocally() overrides them for buffered ones.
  doc["is_offline_buffered"] = false;
  doc["record_source"]       = "realtime";

  // ── TRANSMISSION ─────────────────────────────────────────────
  if (WiFi.status() != WL_CONNECTED) {
    Serial.println("[WiFi] Disconnected — storing reading locally.");
    storeLocally(doc);   // stamps is_offline_buffered=true + record_source
    connectWiFi();       // attempt reconnect; LCD already updated above
  } else {
    if (!mqttClient.connected()) {
      Serial.println("[MQTT] Disconnected — reconnecting...");
      connectMQTT();
    }

    if (mqttClient.connected()) {
      sendBacklog();   // Drain any offline backlog first

      String payload;
      serializeJson(doc, payload);
      Serial.print("[MQTT] Publishing: ");
      Serial.println(payload);
      bool ok = mqttClient.publish(MQTT_TOPIC, payload, false, 1);  // QoS 1
      if (!ok) {
        Serial.println("[MQTT] Publish failed — storing locally.");
        storeLocally(doc);
      } else {
        Serial.println("[MQTT] Published OK (QoS 1 PUBACK expected).");
      }
    } else {
      Serial.println("[MQTT] Broker unreachable — storing locally.");
      storeLocally(doc);
    }
  }

  delay(60000);   // 1 reading per minute — LCD already updated before this block
}
